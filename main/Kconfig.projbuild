## main/Kconfig.projbuild
```kconfig
menu "Train MCU Configuration"

    config ESP_WIFI_SSID
        string "WiFi SSID"
        default "TrainControl"
        help
            SSID of the WiFi network to connect to.

    config ESP_WIFI_PASSWORD
        string "WiFi Password"
        default "train1234"
        help
            Password of the WiFi network to connect to.

    config ESP_MQTT_BROKER_URL
        string "MQTT Broker URL"
        default "mqtt://192.168.4.1:1883"
        help
            URL of the MQTT broker.

endmenu
```

## sdkconfig.defaults
```kconfig
# ESP32 config defaults
CONFIG_ESP_WIFI_AUTH_WPA2_PSK=y
CONFIG_ESP_WIFI_SSID="TrainControl"
CONFIG_ESP_WIFI_PASSWORD="train1234"
CONFIG_ESP_MQTT_BROKER_URL="mqtt://192.168.4.1:1883"

# Common settings
CONFIG_FREERTOS_HZ=1000
CONFIG_LOG_DEFAULT_LEVEL_INFO=y

# NVS
CONFIG_NVS_ENABLED=y
```
